/ {
    underglow {
        compatible = "zmk,underglow";
        chain-length = <58>; // Anzahl deiner LEDs!
        color-mapping = <0 1 2>;
    };
};

&spi1 {
    status = "okay";

    led_strip: ws2812@0 {
        compatible = "worldsemi,ws2812-spi";
        reg = <0>;
        spi-max-frequency = <4000000>;
    };
};
